## conf/layer.conf
```bitbake
# We have a conf and classes directory, add to BBPATH
BBPATH .= ":${LAYERDIR}"

# We have recipes-* directories, add to BBFILES
BBFILES += "${LAYERDIR}/recipes-*/*/*.bb \
            ${LAYERDIR}/recipes-*/*/*.bbappend"

BBFILE_COLLECTIONS += "meta-fossa"
BBFILE_PATTERN_meta-fossa = "^${LAYERDIR}/"
BBFILE_PRIORITY_meta-fossa = "6"

LAYERDEPENDS_meta-fossa = "core"
LAYERSERIES_COMPAT_meta-fossa = "mickledore"

# TODO: confirm following yocto release works as well,
# before explicitly adding them into `LAYERSERIES_COMPAT_meta`.
#
# - mickledore
#
# https://wiki.yoctoproject.org/wiki/Releases

# Default options
include conf/fossa.conf
```
